## boards/arm/waveshare_nrf52840_eval/Kconfig.board
```kconfig
# Copyright (c) 2022 Nordic Semiconductor ASA
# SPDX-License-Identifier: Apache-2.0

config BOARD_WAVESHARE_NRF52840_EVAL
	bool "Waveshare nRF52840 Eval"
	depends on SOC_NRF52840_QIAA
```

## boards/arm/waveshare_nrf52840_eval/Kconfig.defconfig
```kconfig
# Copyright (c) 2022 Nordic Semiconductor ASA
# SPDX-License-Identifier: Apache-2.0

if BOARD_WAVESHARE_NRF52840_EVAL

config BOARD
	default "waveshare_nrf52840_eval"

config BT_CTLR
   default BT

endif
```

## boards/arm/waveshare_nrf52840_eval/waveshare_nrf52840_eval_defconfig
```kconfig
# Copyright (c) 2022 Nordic Semiconductor ASA
# SPDX-License-Identifier: Apache-2.0

CONFIG_SOC_SERIES_NRF52X=y
CONFIG_SOC_NRF52840_QIAA=y
CONFIG_BOARD_WAVESHARE_NRF52840_EVAL=y

# Enable MPU
CONFIG_ARM_MPU=y

# Enable hardware stack protection
CONFIG_HW_STACK_PROTECTION=y

CONFIG_SERIAL=y
CONFIG_CONSOLE=y
CONFIG_UART_CONSOLE=y
```
